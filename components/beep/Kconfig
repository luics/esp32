## components/beep/Kconfig
```kconfig
menu "蜂鸣器配置"
    config BEEP_GPIO
        int "无源蜂鸣器输出 GPIO"
        range 0 30 if IDF_TARGET_ESP32C6
        range 0 48
        default 3
        help
            外接无源压电蜂鸣器正极连接此 GPIO，负极连接 GND。
            此引脚须与灯珠、按钮及其他外设引脚不同。

    config BEEP_FREQUENCY_HZ
        int "摩斯码音调频率（Hz）"
        range 100 10000
        default 2000
        help
            LEDC 输出方波驱动无源蜂鸣器，默认使用 2 kHz 提示音。

endmenu
```

## components/blink/Kconfig
```kconfig
menu "WS2812 组件配置"
    config BLINK_LED_ORDER_GRB
        bool "使用 GRB 数据顺序（Wokwi NeoPixel）"
        default n
        help
            微雪 ESP32-C6-Zero 板载灯使用 RGB 顺序，保持关闭。
            Wokwi NeoPixel 使用 GRB 顺序，仿真构建中启用，避免红绿颠倒。
endmenu
```

## components/button_input/Kconfig
```kconfig
menu "按钮输入配置"
    config BUTTON_INPUT_GPIO
        int "绿色历史翻页按钮 GPIO（低电平按下）"
        range 0 30 if IDF_TARGET_ESP32C6
        range 0 48
        default 9
        help
            微雪 ESP32-C6-Zero 的 BOOT 按钮连接 GPIO9，按下接地。
            驱动开启内部上拉并处理消抖。GPIO9 也是启动配置引脚，
            请在正常启动后按下，复位时保持松开。
    config BUTTON_INPUT_RED_GPIO
        int "红色摩斯码按键 GPIO（低电平按下）"
        range 0 30 if IDF_TARGET_ESP32C6
        range 0 48
        default 0
        help
            红色按钮连接此 GPIO 与 GND，内部上拉并使用软件消抖。
            松开时按按住时长识别点划：不足3单位为点，达到3单位为划。
            双键模式下每次按下缓存标准点，长按连续重复。
            引脚须与绿色按钮及灯珠数据引脚不同。

    config BUTTON_INPUT_BLACK_GPIO
        int "黑色双键模式划按钮 GPIO（低电平按下）"
        range 0 30 if IDF_TARGET_ESP32C6
        range 0 48
        default 1
        help
            黑色按钮连接此 GPIO 与 GND，复用内部上拉与消抖。
            仅双键模式有效：按下缓存标准划，长按连续重复。
            引脚须与其他按钮和外设不同。

    config BUTTON_INPUT_MODE_GPIO
        int "灰色单键/双键模式切换按钮 GPIO（低电平按下）"
        range 0 30 if IDF_TARGET_ESP32C6
        range 0 48
        default 2
        help
            灰色按钮连接此 GPIO 与 GND，每次按下切换一次模式。
            默认双键模式，长按不重复切换；引脚须与其他外设不同。

    config BUTTON_INPUT_BLUE_GPIO
        int "蓝色复位按钮 GPIO（低电平按下）"
        range 0 30 if IDF_TARGET_ESP32C6
        range 0 48
        default 11
        help
            蓝色按钮连接此 GPIO 与 GND，复用内部上拉与消抖驱动。
            按下后应用调用 esp_restart，重新执行统一的启动初始化流程。
            引脚须与红绿按钮、灯珠及其他外设不同。

endmenu
```

## components/display/Kconfig
```kconfig
menu "显示屏配置"
    config DISPLAY_WOKWI_SH1107
        bool "Wokwi SH1107 128x128 OLED 替代屏"
        default n
        help
            仿真 SSD1327 屏幕的分辨率与黑白布局，不模拟 16 级灰度或 SSD1327 协议。
            使用 I2C，DISPLAY_SCLK_GPIO 为 SCL，DISPLAY_MOSI_GPIO 为 SDA；
            不使用 CS/DC/RST。关闭时使用 SSD1327 实板 SPI 驱动。

    config DISPLAY_SCLK_GPIO
        int "显示屏时钟 GPIO（SPI SCK / 仿真 I2C SCL）"
        range 0 30 if IDF_TARGET_ESP32C6
        range 0 48
        default 6 if DISPLAY_WOKWI_SH1107
        default 21
        help
            显示屏时钟引脚，须与其他显示、按钮、蜂鸣器和灯珠引脚不同。

    config DISPLAY_MOSI_GPIO
        int "显示屏数据 GPIO（SPI MOSI / 仿真 I2C SDA）"
        range 0 30 if IDF_TARGET_ESP32C6
        range 0 48
        default 7 if DISPLAY_WOKWI_SH1107
        default 22
        help
            显示屏数据引脚，须与其他显示、按钮、蜂鸣器和灯珠引脚不同。

    config DISPLAY_CS_GPIO
        int "SSD1327 片选 GPIO"
        range 0 30 if IDF_TARGET_ESP32C6
        range 0 48
        default 18
        help
            SSD1327 的片选引脚，须与其他显示、按钮、蜂鸣器和灯珠引脚不同。

    config DISPLAY_DC_GPIO
        int "SSD1327 数据/命令 GPIO"
        range 0 30 if IDF_TARGET_ESP32C6
        range 0 48
        default 19
        help
            SSD1327 的数据/命令引脚，须与其他显示、按钮、蜂鸣器和灯珠引脚不同。

    config DISPLAY_RST_GPIO
        int "SSD1327 复位 GPIO"
        range 0 30 if IDF_TARGET_ESP32C6
        range 0 48
        default 20
        help
            SSD1327 的复位引脚，须与其他显示、按钮、蜂鸣器和灯珠引脚不同。

endmenu
```

## components/interval_control/Kconfig
```kconfig
menu "摩斯码间隔控制配置"

    config INTERVAL_CONTROL_ENABLED
        bool "启用间隔电位器 ADC 采样"
        default y if DISPLAY_WOKWI_SH1107
        default n
        help
            仅在接好电位器时启用，避免悬空 ADC 随机跳档。
            关闭时不初始化 ADC 或启动采样任务，固定使用 100 ms，
            不占用电位器 GPIO；Wokwi 默认启用，实板默认关闭。

    config INTERVAL_CONTROL_ADC_GPIO
        int "间隔电位器 ADC 引脚"
        depends on INTERVAL_CONTROL_ENABLED
        range 0 30 if IDF_TARGET_ESP32C6
        range 0 48
        default 4
        help
            单联电位器滑臂（SIG）连接到此 ADC 输入。
            微雪 ESP32-C6-Zero 默认使用 GPIO4（ADC1 通道4）。

    config INTERVAL_CONTROL_SAMPLE_INTERVAL_MS
        int "间隔采样间隔（毫秒）"
        depends on INTERVAL_CONTROL_ENABLED
        range 10 1000
        default 50
        help
            后台读取电位器并更新 200/150/100/60 ms 四档时间单位的周期。

endmenu
```

## components/pir_sensor/Kconfig
```kconfig
menu "PIR 人体运动传感器"

    config PIR_SENSOR_GPIO
        int "PIR OUT 输入引脚"
        range 0 30 if IDF_TARGET_ESP32C6
        range 0 48
        default 15
        help
            PIR 的 OUT 接此 GPIO，高电平表示检测到运动。
            GPIO15 用于微雪 ESP32-C6-Zero 和 Wokwi 仿真。

endmenu
```

## components/telegraph_ha/Kconfig
```kconfig
menu "Telegraph Home Assistant"
    config TELEGRAPH_HA_ENABLED
        bool "Enable Home Assistant MQTT Discovery"
        default n
        select MBEDTLS_CERTIFICATE_BUNDLE
        help
            Reuses Wi-Fi configured under Telegraph API synchronization.
            MQTT runs independently of the HTTPS synchronization worker.
    if TELEGRAPH_HA_ENABLED
    config TELEGRAPH_HA_BROKER_URI
        string "MQTT Broker URI"
        default ""
        help
            mqtt://host:1883 for a trusted local network, or mqtts://host:8883
            with a public CA certificate. Never embed credentials in the URI.
    config TELEGRAPH_HA_USERNAME
        string "MQTT username"
        default ""
    config TELEGRAPH_HA_PASSWORD
        string "MQTT password (local generated config only)"
        default ""
        help
            Never commit credentials to defaults or source control.
    endif
endmenu
```

## components/telegraph_sync/Kconfig
```kconfig
menu "Telegraph API synchronization"
    config TELEGRAPH_SYNC_WIFI_SSID
        string "Wi-Fi SSID (shared by HTTPS and Home Assistant)"
        default "Wokwi-GUEST" if DISPLAY_WOKWI_SH1107
        default ""
        help
            Network shared by the Telegraph API and Home Assistant MQTT.
            Empty disables networking.
            Configure real device credentials locally; never commit secrets.
    config TELEGRAPH_SYNC_WIFI_PASSWORD
        string "Wi-Fi password"
        default ""
        help
            Password for the configured network. Empty for open networks.
            Stored only in local generated sdkconfig; never commit secrets.
    config TELEGRAPH_SYNC_BASE_URL
        string "Telegraph HTTPS base URL (empty disables API only)"
        default "https://telegraph-iot.bryanxu.top"
        help
            POST /api/telegraph creates a word; PATCH updates its UUID.
            Empty disables HTTP requests while keeping Wi-Fi for MQTT.
endmenu
```

## components/volume_control/Kconfig
```kconfig
menu "蜂鸣器音量控制配置"

    config VOLUME_CONTROL_ADC_GPIO
        int "蜂鸣器音量电位器 ADC 引脚"
        range 0 30 if IDF_TARGET_ESP32C6
        range 0 48
        default 4
        help
            单联电位器滑臂（SIG）连接到此 ADC 输入。
            微雪 ESP32-C6-Zero 默认使用 GPIO4（ADC1 通道4）。

    config VOLUME_CONTROL_SAMPLE_INTERVAL_MS
        int "蜂鸣器音量采样间隔（毫秒）"
        range 10 1000
        default 50
        help
            后台读取电位器并更新蜂鸣器音量的周期。

endmenu
```

## main/Kconfig.projbuild
```kconfig
menu "摩斯码电报机配置"

    config BLINK_RGB_GPIO
        int "板载点划 RGB LED 数据引脚"
        range 0 30 if IDF_TARGET_ESP32C6
        range 0 48
        default 8
        help
            板载灯连接 GPIO8：点显示红光，划显示绿光。
            微雪 ESP32-C6-Zero 使用 RGB 顺序，Wokwi 构建使用 GRB。

    config BLINK_MODE_GPIO
        int "外接点划/模式/PIR 提示 WS2812 数据引脚"
        range 0 30 if IDF_TARGET_ESP32C6
        range 0 48
        default 5
        help
            外接 WS2812 DIN 连接 GPIO5，采用 GRB 顺序。
            每次按下模式按钮闪黄光 200 ms，空闲时显示 PIR 提示；须与其他外设引脚不同。

endmenu
```

## sdkconfig.defaults
```kconfig
CONFIG_IDF_TARGET="esp32c6"
CONFIG_ESPTOOLPY_FLASHSIZE_8MB=y
# Wi-Fi/HTTPS 联网固件超过 1 MiB，使用 1500 KiB 单应用分区，仍不启用 OTA。
CONFIG_PARTITION_TABLE_SINGLE_APP_LARGE=y
# 重连同一 API 时保存并复用 TLS 会话票据，避免反复完整握手。
CONFIG_ESP_TLS_CLIENT_SESSION_TICKETS=y
CONFIG_BLINK_RGB_GPIO=8
CONFIG_BLINK_MODE_GPIO=5
# 实板原生 USB 日志与 Wokwi UART 日志同时可用。
CONFIG_ESP_CONSOLE_UART_DEFAULT=y
CONFIG_ESP_CONSOLE_SECONDARY_USB_SERIAL_JTAG=y
CONFIG_BUTTON_INPUT_GPIO=9
CONFIG_BUTTON_INPUT_RED_GPIO=0
CONFIG_BUTTON_INPUT_BLUE_GPIO=11
CONFIG_BUTTON_INPUT_BLACK_GPIO=1
CONFIG_BUTTON_INPUT_MODE_GPIO=14
# 实板 WS2812 使用 RGB 顺序。
# CONFIG_BLINK_LED_ORDER_GRB is not set
CONFIG_BEEP_GPIO=3
CONFIG_BEEP_FREQUENCY_HZ=2000
# 实板使用侧边排针，避免焊接背面 GPIO6/7 焊盘。
CONFIG_DISPLAY_SCLK_GPIO=21
CONFIG_DISPLAY_MOSI_GPIO=22
CONFIG_DISPLAY_CS_GPIO=18
CONFIG_DISPLAY_DC_GPIO=19
CONFIG_DISPLAY_RST_GPIO=20
# 实板未接电位器时固定 100 ms，避免悬空 ADC 跳档。
# CONFIG_INTERVAL_CONTROL_ENABLED is not set
CONFIG_INTERVAL_CONTROL_ADC_GPIO=4
CONFIG_INTERVAL_CONTROL_SAMPLE_INTERVAL_MS=50

# IoT 私有 CA 对应的新入口；覆盖旧构建中仍使用默认值的域名。
CONFIG_TELEGRAPH_SYNC_BASE_URL="https://telegraph-iot.bryanxu.top"
```
